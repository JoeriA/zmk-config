## config/west.yml
```yaml
manifest:
  remotes:
    - name: zmkfirmware
      url-base: https://github.com/zmkfirmware
    # nice-view-gem
    # - name: m165437 #new entry
    #   url-base: https://github.com/M165437 #new entry
    # nice_view_elemental
    - name: kevinpastor
      url-base: https://github.com/kevinpastor
  projects:
    - name: zmk
      remote: zmkfirmware
      revision: v0.3
      import: app/west.yml
    - name: nice-view-elemental
      remote: kevinpastor
      revision: main
  self:
    path: config
```
